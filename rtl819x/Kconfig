## rtl819x/Kconfig
```kconfig
mainmenu "RLX Linux Configuration"

comment  "select components"
choice
  prompt "Selected Target"
config BOARD_rtl8196c
	bool "rtl8196c"
config BOARD_rtl8198
	bool "rtl8198"
endchoice

config BOARDDIR
 string

##############################################################


choice
	prompt "Selected Kernel"
	default LINUX_2.6.30

config LINUX_2.6.30
	bool "linux-2.6.30"

endchoice

config LINUXDIR
	string

choice
  prompt "Selected Busybox"
config BZBOX_busybox-1.13
	bool "busybox-1.13"
endchoice

config BZBOXDIR
 string

choice
  prompt "Selected toolchain"
config RSDK_rsdk-1.3.6-4181-EB-2.6.30-0.9.30
	bool "rsdk-1.3.6-4181-EB-2.6.30-0.9.30"
config RSDK_rsdk-1.3.6-5281-EB-2.6.30-0.9.30
	bool "rsdk-1.3.6-5281-EB-2.6.30-0.9.30"
endchoice

config RSDKDIR
 string

if BOARD_rtl8196c
	source "boards/rtl8196c/board-configuration.in"
endif
if BOARD_rtl8198
	source "boards/rtl8198/board-configuration.in"
endif
##############################################################

comment  "config components"
config MCONF_LINUX
	bool "Config kernel"

config MCONF_USERS
	bool "Config users"
config MCONF_BZBOX
	bool "Config busybox"
config MCONF_LOAD
	bool "Load default settings"

config MCONF_SAVE
	bool "Save default settings"
```
